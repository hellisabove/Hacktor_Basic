## build/Kconfig/boards/Kconfig.defconfig
```kconfig
# Load Zephyr board defconfig descriptions.
osource "/home/nedi/zephyrproject/zephyr/boards/espressif/esp32s3_devkitc/Kconfig.defconfig"
```

## build/Kconfig/boards/Kconfig.esp32s3_devkitc
```kconfig
# Load board Kconfig descriptions.
osource "/home/nedi/zephyrproject/zephyr/boards/espressif/esp32s3_devkitc/Kconfig.esp32s3_devkitc"
```

## build/Kconfig/boards/Kconfig.sysbuild
```kconfig
# Load Sysbuild board Kconfig descriptions.
osource "/home/nedi/zephyrproject/zephyr/boards/espressif/esp32s3_devkitc/Kconfig.sysbuild"
```

## build/Kconfig/soc/Kconfig
```kconfig
# Load Zephyr SoC Kconfig descriptions.
osource "/home/nedi/zephyrproject/zephyr/soc/xlnx/zynqmp/Kconfig"
osource "/home/nedi/zephyrproject/zephyr/soc/xlnx/zynq7000/Kconfig"
osource "/home/nedi/zephyrproject/zephyr/soc/xlnx/versalnet/Kconfig"
osource "/home/nedi/zephyrproject/zephyr/soc/xlnx/versal2/Kconfig"
osource "/home/nedi/zephyrproject/zephyr/soc/xen/Kconfig"
osource "/home/nedi/zephyrproject/zephyr/soc/wch/ch32v/Kconfig"
osource "/home/nedi/zephyrproject/zephyr/soc/ti/simplelink/Kconfig"
osource "/home/nedi/zephyrproject/zephyr/soc/ti/mspm0/Kconfig"
osource "/home/nedi/zephyrproject/zephyr/soc/ti/lm3s6965/Kconfig"
osource "/home/nedi/zephyrproject/zephyr/soc/ti/k3/Kconfig"
osource "/home/nedi/zephyrproject/zephyr/soc/telink/tlsr/Kconfig"
osource "/home/nedi/zephyrproject/zephyr/soc/starfive/jh71xx/Kconfig"
osource "/home/nedi/zephyrproject/zephyr/soc/st/stm32/Kconfig"
osource "/home/nedi/zephyrproject/zephyr/soc/snps/qemu_arc/Kconfig"
osource "/home/nedi/zephyrproject/zephyr/soc/snps/nsim/arc_v/Kconfig"
osource "/home/nedi/zephyrproject/zephyr/soc/snps/nsim/arc_classic/Kconfig"
osource "/home/nedi/zephyrproject/zephyr/soc/snps/hsdk4xd/Kconfig"
osource "/home/nedi/zephyrproject/zephyr/soc/snps/hsdk/Kconfig"
osource "/home/nedi/zephyrproject/zephyr/soc/snps/emsk/Kconfig"
osource "/home/nedi/zephyrproject/zephyr/soc/snps/emsdp/Kconfig"
osource "/home/nedi/zephyrproject/zephyr/soc/snps/arc_iot/Kconfig"
osource "/home/nedi/zephyrproject/zephyr/soc/silabs/Kconfig"
osource "/home/nedi/zephyrproject/zephyr/soc/sifli/sf32/Kconfig"
osource "/home/nedi/zephyrproject/zephyr/soc/sifive/sifive_freedom/Kconfig"
osource "/home/nedi/zephyrproject/zephyr/soc/sensry/Kconfig"
osource "/home/nedi/zephyrproject/zephyr/soc/rockchip/Kconfig"
osource "/home/nedi/zephyrproject/zephyr/soc/renode/riscv_virtual/Kconfig"
osource "/home/nedi/zephyrproject/zephyr/soc/renode/cortex_r8_virtual/Kconfig"
osource "/home/nedi/zephyrproject/zephyr/soc/renesas/smartbond/Kconfig"
osource "/home/nedi/zephyrproject/zephyr/soc/renesas/rz/Kconfig"
osource "/home/nedi/zephyrproject/zephyr/soc/renesas/rx/Kconfig"
osource "/home/nedi/zephyrproject/zephyr/soc/renesas/rcar/Kconfig"
osource "/home/nedi/zephyrproject/zephyr/soc/renesas/ra/Kconfig"
osource "/home/nedi/zephyrproject/zephyr/soc/realtek/ec/Kconfig"
osource "/home/nedi/zephyrproject/zephyr/soc/raspberrypi/rpi_pico/Kconfig"
osource "/home/nedi/zephyrproject/zephyr/soc/quicklogic/eos_s3/Kconfig"
osource "/home/nedi/zephyrproject/zephyr/soc/qemu/virt_riscv/Kconfig"
osource "/home/nedi/zephyrproject/zephyr/soc/qemu/malta/Kconfig"
osource "/home/nedi/zephyrproject/zephyr/soc/openisa/rv32m1/Kconfig"
osource "/home/nedi/zephyrproject/zephyr/soc/openhwgroup/cva6/Kconfig"
osource "/home/nedi/zephyrproject/zephyr/soc/oct/osd32mp15x/Kconfig"
osource "/home/nedi/zephyrproject/zephyr/soc/nxp/s32/Kconfig"
osource "/home/nedi/zephyrproject/zephyr/soc/nxp/rw/Kconfig"
osource "/home/nedi/zephyrproject/zephyr/soc/nxp/mcx/Kconfig"
osource "/home/nedi/zephyrproject/zephyr/soc/nxp/lpc/Kconfig"
osource "/home/nedi/zephyrproject/zephyr/soc/nxp/layerscape/Kconfig"
osource "/home/nedi/zephyrproject/zephyr/soc/nxp/kinetis/Kconfig"
osource "/home/nedi/zephyrproject/zephyr/soc/nxp/imxrt/Kconfig"
osource "/home/nedi/zephyrproject/zephyr/soc/nxp/imx/Kconfig"
osource "/home/nedi/zephyrproject/zephyr/soc/nuvoton/numicro/Kconfig"
osource "/home/nedi/zephyrproject/zephyr/soc/nuvoton/numaker/Kconfig"
osource "/home/nedi/zephyrproject/zephyr/soc/nuvoton/npcx/Kconfig"
osource "/home/nedi/zephyrproject/zephyr/soc/nuvoton/npcm/Kconfig"
osource "/home/nedi/zephyrproject/zephyr/soc/nordic/Kconfig"
osource "/home/nedi/zephyrproject/zephyr/soc/neorv32/Kconfig"
osource "/home/nedi/zephyrproject/zephyr/soc/native/inf_clock/Kconfig"
osource "/home/nedi/zephyrproject/zephyr/soc/microchip/sam/Kconfig"
osource "/home/nedi/zephyrproject/zephyr/soc/microchip/sam/sama7/Kconfig"
osource "/home/nedi/zephyrproject/zephyr/soc/microchip/sam/sam_d5x_e5x/Kconfig"
osource "/home/nedi/zephyrproject/zephyr/soc/microchip/pic32c/pic32cz_ca/Kconfig"
osource "/home/nedi/zephyrproject/zephyr/soc/microchip/pic32c/pic32cx_sg/Kconfig"
osource "/home/nedi/zephyrproject/zephyr/soc/microchip/pic32c/pic32cm_jh/Kconfig"
osource "/home/nedi/zephyrproject/zephyr/soc/microchip/miv/Kconfig"
osource "/home/nedi/zephyrproject/zephyr/soc/microchip/mec/Kconfig"
osource "/home/nedi/zephyrproject/zephyr/soc/mediatek/mt8xxx/Kconfig"
osource "/home/nedi/zephyrproject/zephyr/soc/lowrisc/opentitan/Kconfig"
osource "/home/nedi/zephyrproject/zephyr/soc/litex/litex_vexriscv/Kconfig"
osource "/home/nedi/zephyrproject/zephyr/soc/ite/ec/Kconfig"
osource "/home/nedi/zephyrproject/zephyr/soc/intel/raptor_lake/Kconfig"
osource "/home/nedi/zephyrproject/zephyr/soc/intel/panther_lake/Kconfig"
osource "/home/nedi/zephyrproject/zephyr/soc/intel/lakemont/Kconfig"
osource "/home/nedi/zephyrproject/zephyr/soc/intel/intel_socfpga_std/Kconfig"
osource "/home/nedi/zephyrproject/zephyr/soc/intel/intel_socfpga/Kconfig"
osource "/home/nedi/zephyrproject/zephyr/soc/intel/intel_niosv/Kconfig"
osource "/home/nedi/zephyrproject/zephyr/soc/intel/intel_ish/Kconfig"
osource "/home/nedi/zephyrproject/zephyr/soc/intel/intel_adsp/Kconfig"
osource "/home/nedi/zephyrproject/zephyr/soc/intel/elkhart_lake/Kconfig"
osource "/home/nedi/zephyrproject/zephyr/soc/intel/atom/Kconfig"
osource "/home/nedi/zephyrproject/zephyr/soc/intel/apollo_lake/Kconfig"
osource "/home/nedi/zephyrproject/zephyr/soc/intel/alder_lake/Kconfig"
osource "/home/nedi/zephyrproject/zephyr/soc/infineon/edge/Kconfig"
osource "/home/nedi/zephyrproject/zephyr/soc/infineon/cat3/Kconfig"
osource "/home/nedi/zephyrproject/zephyr/soc/infineon/cat1c/Kconfig"
osource "/home/nedi/zephyrproject/zephyr/soc/infineon/cat1b/Kconfig"
osource "/home/nedi/zephyrproject/zephyr/soc/infineon/cat1a/Kconfig"
osource "/home/nedi/zephyrproject/zephyr/soc/gd/gd32/Kconfig"
osource "/home/nedi/zephyrproject/zephyr/soc/gaisler/leon3/Kconfig"
osource "/home/nedi/zephyrproject/zephyr/soc/gaisler/gr716a/Kconfig"
osource "/home/nedi/zephyrproject/zephyr/soc/espressif/Kconfig"
osource "/home/nedi/zephyrproject/zephyr/soc/ene/kb1200/Kconfig"
osource "/home/nedi/zephyrproject/zephyr/soc/ene/kb106x/Kconfig"
osource "/home/nedi/zephyrproject/zephyr/soc/egis/Kconfig"
osource "/home/nedi/zephyrproject/zephyr/soc/efinix/sapphire/Kconfig"
osource "/home/nedi/zephyrproject/zephyr/soc/cdns/xtensa_sample_controller/Kconfig"
osource "/home/nedi/zephyrproject/zephyr/soc/cdns/sample_controller32/Kconfig"
osource "/home/nedi/zephyrproject/zephyr/soc/cdns/dc233c/Kconfig"
osource "/home/nedi/zephyrproject/zephyr/soc/brcm/bcmvk/Kconfig"
osource "/home/nedi/zephyrproject/zephyr/soc/brcm/bcm2712/Kconfig"
osource "/home/nedi/zephyrproject/zephyr/soc/brcm/bcm2711/Kconfig"
osource "/home/nedi/zephyrproject/zephyr/soc/bflb/Kconfig"
osource "/home/nedi/zephyrproject/zephyr/soc/atmel/sam0/Kconfig"
osource "/home/nedi/zephyrproject/zephyr/soc/atmel/sam/Kconfig"
osource "/home/nedi/zephyrproject/zephyr/soc/aspeed/Kconfig"
osource "/home/nedi/zephyrproject/zephyr/soc/arm/Kconfig"
osource "/home/nedi/zephyrproject/zephyr/soc/arm/beetle/Kconfig"
osource "/home/nedi/zephyrproject/zephyr/soc/antmicro/myra/Kconfig"
osource "/home/nedi/zephyrproject/zephyr/soc/andestech/Kconfig"
osource "/home/nedi/zephyrproject/zephyr/soc/amd/acp_6_0/Kconfig"
osource "/home/nedi/zephyrproject/zephyr/soc/ambiq/Kconfig"
osource "/home/nedi/zephyrproject/zephyr/soc/aesc/Kconfig"
osource "/home/nedi/zephyrproject/zephyr/soc/adi/max32/Kconfig"
```
