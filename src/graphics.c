#include "graphics.h"
#include <zephyr/drivers/display.h>
#include <string.h>
#include <stdlib.h>
#include <math.h>

static const uint8_t kFont5x7[96][5] = {
  {0x00,0x00,0x00,0x00,0x00}, {0x00,0x00,0x5f,0x00,0x00}, {0x00,0x03,0x00,0x03,0x00}, {0x14,0x7f,0x14,0x7f,0x14},
  {0x24,0x2a,0x7f,0x2a,0x12}, {0x23,0x13,0x08,0x64,0x62}, {0x36,0x49,0x55,0x22,0x50}, {0x00,0x05,0x03,0x00,0x00},
  {0x00,0x1c,0x22,0x41,0x00}, {0x00,0x41,0x22,0x1c,0x00}, {0x14,0x08,0x3e,0x08,0x14}, {0x08,0x08,0x3e,0x08,0x08},
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  {0x00,0x00,0x7f,0x00,0x00}, {0x00,0x41,0x36,0x08,0x00}, {0x10,0x08,0x08,0x10,0x08}, {0x00,0x00,0x00,0x00,0x00}
};

void graphics_draw_pixel(const struct device *dev, int16_t x, int16_t y, uint16_t color) {
    struct display_capabilities caps;
    display_get_capabilities(dev, &caps);
    if (x < 0 || y < 0 || x >= caps.x_resolution || y >= caps.y_resolution) return;

    struct display_buffer_descriptor desc = {
        .buf_size = 2,
        .width = 1,
        .height = 1,
        .pitch = 1
    };
    uint16_t swapped = __builtin_bswap16(color);
    display_write(dev, x, y, &desc, &swapped);
}

void graphics_fill_rect(const struct device *dev, int16_t x, int16_t y, int16_t w, int16_t h, uint16_t color) {
    struct display_capabilities caps;
    display_get_capabilities(dev, &caps);

    if (x >= caps.x_resolution || y >= caps.y_resolution || x + w <= 0 || y + h <= 0) return;

    int16_t x0 = x < 0 ? 0 : x;
    int16_t y0 = y < 0 ? 0 : y;
    int16_t x1 = (x + w) > caps.x_resolution ? caps.x_resolution : (x + w);
    int16_t y1 = (y + h) > caps.y_resolution ? caps.y_resolution : (y + h);

    int16_t actual_w = x1 - x0;
    int16_t actual_h = y1 - y0;

    uint16_t swapped = __builtin_bswap16(color);
    uint16_t *line_buf = malloc(actual_w * 2);
    if (!line_buf) return;

    for (int i = 0; i < actual_w; i++) line_buf[i] = swapped;

    struct display_buffer_descriptor desc = {
        .buf_size = actual_w * 2,
        .width = actual_w,
        .height = 1,
        .pitch = actual_w
    };

    for (int i = 0; i < actual_h; i++) {
        display_write(dev, x0, y0 + i, &desc, line_buf);
    }
    free(line_buf);
}

void graphics_fill_screen(const struct device *dev, uint16_t color) {
    struct display_capabilities caps;
    display_get_capabilities(dev, &caps);
    graphics_fill_rect(dev, 0, 0, caps.x_resolution, caps.y_resolution, color);
}

void graphics_draw_line(const struct device *dev, int16_t x0, int16_t y0, int16_t x1, int16_t y1, uint16_t color) {
    if (x0 == x1) {
        if (y0 > y1) { int16_t t = y0; y0 = y1; y1 = t; }
        graphics_fill_rect(dev, x0, y0, 1, y1 - y0 + 1, color);
        return;
    }
    if (y0 == y1) {
        if (x0 > x1) { int16_t t = x0; x0 = x1; x1 = t; }
        graphics_fill_rect(dev, x0, y0, x1 - x0 + 1, 1, color);
        return;
    }

    int16_t dx = abs(x1 - x0), sx = x0 < x1 ? 1 : -1;
    int16_t dy = -abs(y1 - y0), sy = y0 < y1 ? 1 : -1;
    int16_t err = dx + dy, e2;

    for (;;) {
        graphics_draw_pixel(dev, x0, y0, color);
        if (x0 == x1 && y0 == y1) break;
        e2 = 2 * err;
        if (e2 >= dy) { err += dy; x0 += sx; }
        if (e2 <= dx) { err += dx; y0 += sy; }
    }
}

void graphics_fill_triangle(const struct device *dev, int16_t x0, int16_t y0, int16_t x1, int16_t y1, int16_t x2, int16_t y2, uint16_t color) {
    int16_t a, b, y, last;
    if (y0 > y1) { int16_t t; t = y0; y0 = y1; y1 = t; t = x0; x0 = x1; x1 = t; }
    if (y1 > y2) { int16_t t; t = y1; y1 = y2; y2 = t; t = x1; x1 = x2; x2 = t; }
    if (y0 > y1) { int16_t t; t = y0; y0 = y1; y1 = t; t = x0; x0 = x1; x1 = t; }

    if (y0 == y2) {
        a = b = x0;
        if (x1 < a) a = x1; else if (x1 > b) b = x1;
        if (x2 < a) a = x2; else if (x2 > b) b = x2;
        graphics_fill_rect(dev, a, y0, b - a + 1, 1, color);
        return;
    }

    int16_t dx01 = x1 - x0, dy01 = y1 - y0,
            dx02 = x2 - x0, dy02 = y2 - y0,
            dx12 = x2 - x1, dy12 = y2 - y1;
    int32_t sa = 0, sb = 0;

    if (y1 == y2) last = y1; else last = y1 - 1;

    for (y = y0; y <= last; y++) {
        a = x0 + sa / dy01;
        b = x0 + sb / dy02;
        sa += dx01;
        sb += dx02;
        if (a > b) { int16_t t = a; a = b; b = t; }
        graphics_fill_rect(dev, a, y, b - a + 1, 1, color);
    }

    sa = (int32_t)dx12 * (y - y1);
    sb = (int32_t)dx02 * (y - y0);
    for (; y <= y2; y++) {
        a = x1 + sa / dy12;
        b = x0 + sb / dy02;
        sa += dx12;
        sb += dx02;
        if (a > b) { int16_t t = a; a = b; b = t; }
        graphics_fill_rect(dev, a, y, b - a + 1, 1, color);
    }
}

void graphics_fill_circle(const struct device *dev, int16_t x0, int16_t y0, int16_t r, uint16_t color) {
    graphics_fill_rect(dev, x0 - r, y0, 2 * r + 1, 1, color);
    int16_t f = 1 - r;
    int16_t ddF_x = 1;
    int16_t ddF_y = -2 * r;
    int16_t x = 0;
    int16_t y = r;

    while (x < y) {
        if (f >= 0) {
            y--;
            ddF_y += 2;
            f += ddF_y;
        }
        x++;
        ddF_x += 2;
        f += ddF_x;

        graphics_fill_rect(dev, x0 - x, y0 + y, 2 * x + 1, 1, color);
        graphics_fill_rect(dev, x0 - x, y0 - y, 2 * x + 1, 1, color);
        graphics_fill_rect(dev, x0 - y, y0 + x, 2 * y + 1, 1, color);
        graphics_fill_rect(dev, x0 - y, y0 - x, 2 * y + 1, 1, color);
    }
}

static void graphics_draw_char(const struct device *dev, int16_t x, int16_t y, char c, uint16_t color_text, uint16_t color_bg, uint8_t size) {
    if (c < 32 || c > 127) c = 32;
    uint8_t idx = c - 32;
    for (int8_t i = 0; i < 5; i++) {
        uint8_t line = kFont5x7[idx][i];
        for (int8_t j = 0; j < 8; j++, line >>= 1) {
            if (line & 1) {
                if (size == 1) graphics_draw_pixel(dev, x + i, y + j, color_text);
                else graphics_fill_rect(dev, x + i * size, y + j * size, size, size, color_text);
            } else if (color_bg != color_text) {
                if (size == 1) graphics_draw_pixel(dev, x + i, y + j, color_bg);
                else graphics_fill_rect(dev, x + i * size, y + j * size, size, size, color_bg);
            }
        }
    }
}

void graphics_draw_text(const struct device *dev, int16_t x, int16_t y, const char *text, uint16_t color_text, uint16_t color_bg, uint8_t size) {
    while (*text) {
        graphics_draw_char(dev, x, y, *text++, color_text, color_bg, size);
        x += 6 * size;
    }
}
